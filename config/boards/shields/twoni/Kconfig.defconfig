## config/boards/shields/twoni/Kconfig.defconfig
```kconfig
if SHIELD_TWONI_LEFT

config ZMK_KEYBOARD_NAME
	default "Twoni"

config ZMK_SPLIT_BLE_ROLE_CENTRAL
	default y

endif

if SHIELD_TWONI_LEFT || SHIELD_TWONI_RIGHT

config ZMK_SPLIT
	default y

endif
```

## config/boards/shields/twoni/Kconfig.shield
```kconfig
# Copyright (c) 2020 Pete Johanson
# SPDX-License-Identifier: MIT

config SHIELD_TWONI_LEFT
	def_bool $(shields_list_contains,twoni_left)

config SHIELD_TWONI_RIGHT
	def_bool $(shields_list_contains,twoni_right)
```
